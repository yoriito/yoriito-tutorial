VERSION ""

NS_ :

BS_:

BU_: ECU1 ECU2

BO_ 256 VehicleStatus: 8 ECU1
 SG_ Speed       : 0|16@1+ (0.01,0) [0|250] "km/h" ECU2
 SG_ EngineRpm   : 16|16@1+ (0.25,0) [0|8000] "rpm"  ECU2
